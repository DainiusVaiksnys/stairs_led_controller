## components/led_driver/Kconfig.projbuild
```kconfig
menu "LED driver Configuration"

    orsource "$IDF_PATH/examples/common_components/env_caps/$IDF_TARGET/Kconfig.env_caps"

    config I2C_SCL
        int "SCL GPIO Num"
        range ENV_GPIO_RANGE_MIN ENV_GPIO_OUT_RANGE_MAX
        default 22
        help
            GPIO number for I2C Master clock line.

    config I2C_SDA
        int "SDA GPIO Num"
        range ENV_GPIO_RANGE_MIN ENV_GPIO_OUT_RANGE_MAX
        default 21
        help
            GPIO number for I2C Master data line.

    config I2C_DEVICES
        int "Number of connected PWM drivers"
        range 1 62
        default 1
        help
            Set the number of 16-channel PWM drivers to use. Each one having incrementing address starting from 0x40.

    config I2C_STARTING_ADDRESS
        hex "Address of first PWM device"
        range 0x40 0x7f
        default 0x40
        help
            I2C address of first PWM driver device.

endmenu
```

## main/Kconfig.projbuild
```kconfig
menu "REST server Configuration"

    config SERVER_MDNS_HOST_NAME
        string "mDNS Host Name"
        default "laiptai"
        help
            Specify the domain name used in the mDNS service.
            Note that webpage also take it as a part of URL where it will send GET/POST requests to.
endmenu
```
